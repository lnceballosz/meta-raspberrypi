## conf/machine/include/rpi-default-versions.inc
```bitbake
# SPDX-FileCopyrightText: 2012 meta-raspberrypi contributors
# SPDX-License-Identifier: MIT
# RaspberryPi BSP default versions

PREFERRED_VERSION_linux-raspberrypi ??= "5.10.%"
```

## conf/machine/raspberrypi-cm.conf
```bitbake
# SPDX-FileCopyrightText: 2012 meta-raspberrypi contributors
# 
# SPDX-License-Identifier: MIT

@TYPE: Machine
#@NAME: RaspberryPi Compute Module (CM1)
#@DESCRIPTION: Machine configuration for the RaspberryPi Compute Module (CM1)

MACHINEOVERRIDES = "raspberrypi:${MACHINE}"
include conf/machine/raspberrypi.conf

ARMSTUB ?= "armstub.bin"
```
